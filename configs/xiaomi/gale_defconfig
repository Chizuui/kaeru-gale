## configs/xiaomi/gale_defconfig
```kconfig
CONFIG_APP_ADDRESS=0x4C42A3CC
CONFIG_BOOTLOADER_BASE=0x4C400000
CONFIG_BOOTLOADER_SIZE=0x173C00
CONFIG_BOOTMODE_ADDRESS=0x4C5765A4
CONFIG_CERT_BYPASS=y
CONFIG_CERT_BYPASS_MODE="wrap"
CONFIG_DPRINTF_ADDRESS=0x4C440CE4
CONFIG_FASTBOOT_FAIL_ADDRESS=0x4C42B820
CONFIG_FASTBOOT_INFO_ADDRESS=0x4C42B680
CONFIG_FASTBOOT_OKAY_ADDRESS=0x4C42BA00
CONFIG_FASTBOOT_PUBLISH_ADDRESS=0x4C42B22C
CONFIG_FASTBOOT_REGISTER_ADDRESS=0x4C42B1F0
CONFIG_FREE_ADDRESS=0x4C441114
CONFIG_INIT_STORAGE_CALLER=0x4C403A0C
CONFIG_LK_LOG_STORE_ADDRESS=0x4C455694
CONFIG_MALLOC_ADDRESS=0x4C4419E0
CONFIG_MEDIATEK_MT6768=y
CONFIG_MTK_DETECT_KEY_ADDRESS=0x4C4054A8
CONFIG_PLATFORM_INIT_ADDRESS=0x4C4039DC
CONFIG_PLATFORM_INIT_CALLER=0x4C425E0C
CONFIG_THREAD_CREATE_ADDRESS=0x4C4265C8
CONFIG_THREAD_RESUME_ADDRESS=0x4C4267DC
CONFIG_VIDEO_PRINTF_ADDRESS=0x4C42DA1C
CONFIG_XIAOMI_GALE=y
```
